#include <Adafruit_GFX.h>
#include <Adafruit_SSD1306.h>
#include <WiFi.h>
#include <FirebaseESP32.h>
#include <addons/TokenHelper.h>
#include <addons/RTDBHelper.h>
#include <DFRobot_DHT11.h>
#define SCREEN_WIDTH 128
#define SCREEN_HEIGHT 64
#define API_KEY "AIzaSyDQdQy71c-JNIhoORKYvJFMfE6H8ZV-bhk"
#define DATABASE_URL "https://air-sense-monitor-default-rtdb.firebaseio.com"
#define USER_EMAIL "airsense@gmail.com"
#define USER_PASSWORD "123456"
#define WIFI_SSID "Autobonics_4G"
#define WIFI_PASSWORD "autobonics@27"
#define OLED_MOSI   23  // Data (MOSI)
#define OLED_CLK    18  // Clock (SCL)
#define OLED_DC     26   // Data/Command (DC)
#define OLED_CS     5   // Chip Select (CS)
#define OLED_RESET  4   // Reset
DFRobot_DHT11 DHT;
FirebaseData fbdo;
FirebaseAuth auth;
FirebaseConfig config;
#define DHT11_PIN 13
const int buttonPin = 39; // Connect push button to pin 2
int programNumber = 0;   // Current program
const int debounceDelay = 50; // Debounce delay in milliseconds
int buttonState;            // Current button state
int lastButtonState = HIGH; // Last button state
unsigned long lastDebounceTime = 0; // Last time button state changed
int aqi_index;
const int maxPrograms = 3; // Total number of programs (0, 1, 2)
volatile bool buttonPressed = false;
const unsigned char intro_logo [] PROGMEM = {
	0x00, 0x00, 0x00, 0x00, 0x00, 0x00, 0x00, 0x00, 0x00, 0x00, 0x00, 0x00, 0x00, 0x00, 0x00, 0x00, 
	0x00, 0x00, 0x00, 0x00, 0x00, 0x00, 0x00, 0x00, 0x00, 0x00, 0x00, 0x00, 0x00, 0x00, 0x00, 0x00, 
	0x00, 0x00, 0x00, 0x00, 0x00, 0x00, 0x00, 0x00, 0x00, 0x00, 0x00, 0x00, 0x00, 0x00, 0x00, 0x00, 
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	0x00, 0x00, 0x00, 0x00, 0x00, 0x00, 0x00, 0x00, 0x00, 0x00, 0x00, 0x00, 0x00, 0x00, 0x00, 0x00
};
const unsigned char logo[] PROGMEM = {
	0x00, 0x00, 0x00, 0x00, 0x00, 0x00, 0x00, 0x00, 0x00, 0x00, 0x00, 0x00, 0x00, 0x00, 0x00, 0x00, 
	0x00, 0x00, 0x00, 0x00, 0x00, 0x00, 0x00, 0x00, 0x00, 0x00, 0x00, 0x00, 0x00, 0x00, 0x00, 0x00, 
	0x00, 0x00, 0x00, 0x00, 0x00, 0x00, 0x00, 0x00, 0x00, 0x00, 0x00, 0x00, 0x00, 0x00, 0x00, 0x00, 
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	0x00, 0x00, 0x00, 0x00, 0x00, 0x00, 0x00, 0x00, 0x00, 0x00, 0x00, 0x00, 0x00, 0x00, 0x00, 0x00
};
const unsigned char logo2[] PROGMEM = {
	0x00, 0x00, 0x00, 0x00, 0x00, 0x00, 0x00, 0x00, 0x00, 0x00, 0x00, 0x00, 0x00, 0x00, 0x00, 0x00, 
	0x00, 0x00, 0x00, 0x00, 0x00, 0x00, 0x00, 0x00, 0x00, 0x00, 0x00, 0x00, 0x00, 0x00, 0x00, 0x00, 
	0x00, 0x00, 0x00, 0x00, 0x00, 0x00, 0x00, 0x00, 0x00, 0x00, 0x00, 0x00, 0x00, 0x00, 0x00, 0x00, 
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	0x00, 0x00, 0x00, 0x00, 0x00, 0x00, 0x00, 0x00, 0x00, 0x00, 0x00, 0x00, 0x00, 0x00, 0x00, 0x00
};
const unsigned char airquality[] PROGMEM = {
	0x00, 0x00, 0x00, 0x00, 0x00, 0x00, 0x00, 0x00, 0x00, 0x00, 0x00, 0x00, 0x00, 0x00, 0x00, 0x00, 
	0x00, 0x00, 0x00, 0x00, 0x00, 0x00, 0x00, 0x00, 0x00, 0x00, 0x00, 0x00, 0x00, 0x00, 0x00, 0x00, 
	0x00, 0x00, 0x00, 0x00, 0x00, 0x00, 0x00, 0x00, 0x00, 0x00, 0x00, 0x00, 0x00, 0x00, 0x00, 0x00, 
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	0x00, 0x00, 0x00, 0x00, 0x00, 0x00, 0x00, 0x00, 0x00, 0x00, 0x00, 0x00, 0x00, 0x00, 0x00, 0x00
};
const unsigned char dht_2[] PROGMEM = {
	0x00, 0x00, 0x00, 0x00, 0x00, 0x00, 0x00, 0x00, 0x00, 0x00, 0x00, 0x00, 0x00, 0x00, 0x00, 0x00, 
	0x00, 0x00, 0x00, 0x00, 0x00, 0x00, 0x00, 0x00, 0x00, 0x00, 0x00, 0x00, 0x00, 0x00, 0x00, 0x00, 
	0x00, 0x00, 0x00, 0x00, 0x00, 0x00, 0x00, 0x00, 0x00, 0x00, 0x00, 0x00, 0x00, 0x00, 0x00, 0x00, 
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	0x00, 0x00, 0x00, 0x00, 0x00, 0x00, 0x00, 0x00, 0x00, 0x00, 0x00, 0x00, 0x00, 0x00, 0x00, 0x00
};
// Create an SSD1306 SPI instance
Adafruit_SSD1306 display(SCREEN_WIDTH, SCREEN_HEIGHT, &SPI, OLED_DC, OLED_RESET, OLED_CS);

void setup() {
  // Start serial communication for debugging
  Serial.begin(115200);
WiFi.begin(WIFI_SSID, WIFI_PASSWORD);
int timeout = 10; // 10 seconds
  // Initialize the OLED display
  if (!display.begin(SSD1306_SWITCHCAPVCC)) {
    Serial.println(F("SSD1306 allocation failed"));
    for (;;); // Infinite loop if OLED fails to initialize
  }
while (WiFi.status() != WL_CONNECTED && timeout-- > 0) {
  delay(1000);
  Serial.print(".");
    display.clearDisplay();
  display.setTextSize(2);
  display.setTextColor(SSD1306_WHITE);
  display.setCursor(0, 0);
  display.drawBitmap(0, 0, intro_logo, SCREEN_WIDTH, SCREEN_HEIGHT , WHITE);
  display.display();  // Show the message on the scree
  delay(2000);
}
if (WiFi.status() == WL_CONNECTED) {
  Serial.println("\nConnected to Wi-Fi");
} else {
  Serial.println("\nFailed to connect to Wi-Fi");
  return;
}
  config.api_key = API_KEY;
  auth.user.email = USER_EMAIL;
  auth.user.password = USER_PASSWORD;
  config.database_url = DATABASE_URL;
  config.token_status_callback = tokenStatusCallback;
  analogReadResolution(12); // Set ADC resolution to 12 bits
  Firebase.begin(&config, &auth);
  Firebase.reconnectNetwork(true);
  pinMode(buttonPin, INPUT); // Set button pin as input with pull-up
  attachInterrupt(digitalPinToInterrupt(buttonPin), buttonISR, FALLING); // Attach interrupt on falling edge

}

void loop() {

  DHT.read(DHT11_PIN);
  Serial.print(DHT.temperature);
  Serial.println(DHT.humidity);
  aqi_index = abs(aqi());
      if (Firebase.setInt(fbdo, F("airquality/weather/temperature"), DHT.temperature)) {
    Serial.println("temperature pushed successfully!");
  } else {
    Serial.println("Failed to push temperature value: " + fbdo.errorReason());
   }
    if (Firebase.setInt(fbdo, F("airquality/weather/humidity"), DHT.humidity)) {
    Serial.println("humidity pushed successfully!");
  } else {
    Serial.println("Failed to push humidity value: " + fbdo.errorReason());
   }
      if (Firebase.setInt(fbdo, F("airquality/Aqi"), aqi_index)) {
    Serial.println("aqi pushed successfully!");
  } else {
    Serial.println("Failed to push aqi value: " + fbdo.errorReason());
   } 
  // Read the button state
  if (buttonPressed) {
    buttonPressed = false; // Reset the flag
    programNumber++; // Increment program number
    if (programNumber >= maxPrograms) {
      programNumber = 0; // Wrap around
    }
    Serial.print("Switched to program: ");
    Serial.println(programNumber);
  }
  switch (programNumber) {
    case 0:
      displayDht11(); 
      break;
    case 1:
      displayAqi();
      break;
    case 2:
      displayBoth();
      break;
  }
  delay(1000);
}
void displayDht11()
{
  display.clearDisplay();
  display.setTextSize(1);
  display.setTextColor(SSD1306_WHITE);
  display.setCursor(0, 0);
  display.drawBitmap(0, 0, logo2, SCREEN_WIDTH, SCREEN_HEIGHT , WHITE);
  display.setCursor(0, 15);
  display.println(F("TEMPERATURE :"));
  display.setCursor(80, 15);
  display.println(DHT.temperature);
  display.setCursor(0, 40);
  display.println(F("HUMIDITY :"));
  display.setCursor(80, 40);
  display.println(DHT.humidity);
  display.display();  // Show the message on the scree
  delay(2000);
  display.clearDisplay();
  display.setTextSize(1);
  display.setTextColor(SSD1306_WHITE);
  display.setCursor(0, 0);
  display.drawBitmap(0, 0, dht_2, SCREEN_WIDTH, SCREEN_HEIGHT , WHITE);
  display.setCursor(0, 15);
  display.println(F("TEMPERATURE :"));
  display.setCursor(80, 15);
  display.println(DHT.temperature);
  display.setCursor(0, 40);
  display.println(F("HUMIDITY :"));
  display.setCursor(80, 40);
  display.println(DHT.humidity);
  display.display();  // Show the message on the scree
}
int aqi() {
int analogValue = analogRead(36);
Serial.println(analogValue);
delay(100);
int aqi = map(analogValue,1000,4095,0,500);
Serial.print("AQI :");
Serial.println(aqi);
return aqi;
}
void displayAqi()
{
  display.clearDisplay();
  display.setTextSize(2);
  display.setTextColor(SSD1306_WHITE);
  display.setCursor(0, 0);
  display.drawBitmap(0, 0, logo, SCREEN_WIDTH, SCREEN_HEIGHT , WHITE);
  display.setCursor(0, 20);
  display.println(F("AQI:"));
  display.setCursor(45, 20);
  display.println(aqi_index);

  display.display();  // Show the message on the scree
}
void displayBoth()
{
  displayDht11();
  delay(2000);
  displayAqi();
  delay(2000);
}
void buttonISR() {
  // Set the flag to indicate the button was pressed
  buttonPressed = true;
}
